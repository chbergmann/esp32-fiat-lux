## main/Kconfig.projbuild
```kconfig
menu "Fiat Lux Configuration"

    config ESP_WIFI_SSID
        string "WiFi SSID"
        default "myssid"
        help
            SSID (network name) for the example to connect to.

    config ESP_WIFI_PASSWORD
        string "WiFi Password"
        default "mypassword"
        help
            WiFi password (WPA or WPA2) for the example to use.

    choice ESP_WIFI_SAE_MODE
        prompt "WPA3 SAE mode selection"
        default ESP_STATION_EXAMPLE_WPA3_SAE_PWE_BOTH
        help
            Select mode for SAE as Hunt and Peck, H2E or both.
        config ESP_STATION_EXAMPLE_WPA3_SAE_PWE_HUNT_AND_PECK
            bool "HUNT AND PECK"
        config ESP_STATION_EXAMPLE_WPA3_SAE_PWE_HASH_TO_ELEMENT
            bool "H2E"
            depends on ESP_WIFI_ENABLE_SAE_H2E
        config ESP_STATION_EXAMPLE_WPA3_SAE_PWE_BOTH
            bool "BOTH"
            depends on ESP_WIFI_ENABLE_SAE_H2E
    endchoice

    config ESP_WIFI_PW_ID
        string "PASSWORD IDENTIFIER"
        depends on  ESP_STATION_EXAMPLE_WPA3_SAE_PWE_HASH_TO_ELEMENT|| ESP_STATION_EXAMPLE_WPA3_SAE_PWE_BOTH
        default ""
        help
            password identifier for SAE H2E

    config ESP_MAXIMUM_RETRY
        int "Maximum retry"
        default 5
        help
            Set the Maximum retry to avoid station reconnecting to the AP unlimited when the AP is really inexistent.

    choice ESP_WIFI_SCAN_AUTH_MODE_THRESHOLD
        prompt "WiFi Scan auth mode threshold"
        default ESP_WIFI_AUTH_WPA2_PSK
        help
            The weakest authmode to accept in the scan mode.
            This value defaults to ESP_WIFI_AUTH_WPA2_PSK in case password is present and ESP_WIFI_AUTH_OPEN is used.
            Please select ESP_WIFI_AUTH_WEP/ESP_WIFI_AUTH_WPA_PSK in case AP is operating in WEP/WPA mode.

        config ESP_WIFI_AUTH_OPEN
            bool "OPEN"
        config ESP_WIFI_AUTH_WEP
            bool "WEP"
        config ESP_WIFI_AUTH_WPA_PSK
            bool "WPA PSK"
        config ESP_WIFI_AUTH_WPA2_PSK
            bool "WPA2 PSK"
        config ESP_WIFI_AUTH_WPA_WPA2_PSK
            bool "WPA/WPA2 PSK"
        config ESP_WIFI_AUTH_WPA3_PSK
            bool "WPA3 PSK"
        config ESP_WIFI_AUTH_WPA2_WPA3_PSK
            bool "WPA2/WPA3 PSK"
        config ESP_WIFI_AUTH_WAPI_PSK
            bool "WAPI PSK"
    endchoice

    config EXAMPLE_BASIC_AUTH
        bool "Basic Authentication"
        default n
        help
            Basic Authentication is a method for an HTTP user agent (e.g. a web browser)
            to provide a user name and password when making a request. It is the simplest
            technique for enforcing access controls to web resources. because it doesn't
            require cookies, session identifiers, or login pages; rather, it uses standard
            fields in the HTTP header.
            Note that, Basic Authentication is not encrypted channel and also easy to retrieve
            credentials as they are sent in plain text format.

    config EXAMPLE_BASIC_AUTH_USERNAME
        string "Basic Authenticate User Name"
        depends on EXAMPLE_BASIC_AUTH
        default "ESP32"
        help
            The client's user name which used for basic authenticate.

    config EXAMPLE_BASIC_AUTH_PASSWORD
        string "Basic Authenticate Password"
        depends on EXAMPLE_BASIC_AUTH
        default "ESP32Webserver"
        help
            The client's password which used for basic authenticate.

    config EXAMPLE_ENABLE_SSE_HANDLER
        bool "Enable Server-Sent Events (SSE) handler"
        default n
        help
            Enable this option to use Server-Sent Events (SSE) functionality.
            This will allow the server to push real-time updates to the client over an HTTP connection.

    config SNTP_TIME_SERVER
        string "SNTP server name"
        default "pool.ntp.org"
        help
            Hostname of the main SNTP server.

    choice SNTP_TIME_SYNC_METHOD
        prompt "Time synchronization method"
        default SNTP_TIME_SYNC_METHOD_IMMED
        help
            Time synchronization method.

        config SNTP_TIME_SYNC_METHOD_IMMED
            bool "update time immediately when received"
        config SNTP_TIME_SYNC_METHOD_SMOOTH
            bool "update time with smooth method (adjtime)"
        config SNTP_TIME_SYNC_METHOD_CUSTOM
            bool "custom implementation"
    endchoice

    config TIME_ZONE
        string "Time zone"
        default "CET"

    config LED_STRIP1_GPIO_NUM
        int "First LED strip Din GPIO number"
        default 18

    config LED_STRIP2_GPIO_NUM
        int "Second LED strip Din GPIO number. This GPIO number will be increased for the 3rd, 4th, ... LED strip"
        default 10

    config LED_NUMBERS
        int "Default number of LEDs in strip"
        default 5

    config NR_LEDSTRIPS
        int "Number of LED strips"
        default 1

endmenu
menu "HTTP file_serving menu"

    config EXAMPLE_MOUNT_SD_CARD
        bool "Use SD card for file storage"
        default n
        help
            If this config item is set, the file you upload to server can be chosen to save in the SDcard.

    config EXAMPLE_FORMAT_IF_MOUNT_SDCARD_FAILED
        bool "Format the card if mount failed"
        default n
        depends on EXAMPLE_MOUNT_SD_CARD
        help
            If this config item is set, the card will be formatted if mount has failed.

    config EXAMPLE_USE_SDMMC_HOST
        bool "Use SDMMC host"
        default y
        depends on EXAMPLE_MOUNT_SD_CARD && SOC_SDMMC_HOST_SUPPORTED
        help
            If this config item is set, SDMMC is used to mount the SDcard.
            Otherwise, will use SPI host to access and mount the SDcard.

    menu "SD card pin configuration (SPI)"
        depends on EXAMPLE_MOUNT_SD_CARD && !EXAMPLE_USE_SDMMC_HOST

        config EXAMPLE_PIN_MOSI
            int "MOSI GPIO number"
            default 15 if IDF_TARGET_ESP32
            default 35 if IDF_TARGET_ESP32S2
            default 35 if IDF_TARGET_ESP32S3
            default 4  # C3 and others

        config EXAMPLE_PIN_MISO
            int "MISO GPIO number"
            default 2 if IDF_TARGET_ESP32
            default 37 if IDF_TARGET_ESP32S2
            default 37 if IDF_TARGET_ESP32S3
            default 6  # C3 and others

        config EXAMPLE_PIN_CLK
            int "CLK GPIO number"
            default 14 if IDF_TARGET_ESP32
            default 36 if IDF_TARGET_ESP32S2
            default 36 if IDF_TARGET_ESP32S3
            default 5  # C3 and others

        config EXAMPLE_PIN_CS
            int "CS GPIO number"
            default 13 if IDF_TARGET_ESP32
            default 34 if IDF_TARGET_ESP32S2
            default 34 if IDF_TARGET_ESP32S3
            default 1  # C3 and others

    endmenu

    menu "SD card pin configuration (SDMMC)"
        depends on EXAMPLE_USE_SDMMC_HOST && SOC_SDMMC_USE_GPIO_MATRIX

        config EXAMPLE_PIN_CMD
            int "CMD GPIO number"
            default 35 if IDF_TARGET_ESP32S3
            default 1

        config EXAMPLE_PIN_CLK
            int "CLK GPIO number"
            default 36 if IDF_TARGET_ESP32S3
            default 2

        config EXAMPLE_PIN_D0
            int "D0 GPIO number"
            default 37 if IDF_TARGET_ESP32S3
            default 3

        config EXAMPLE_PIN_D1
            int "D1 GPIO number"
            default 38 if IDF_TARGET_ESP32S3
            default 4

        config EXAMPLE_PIN_D2
            int "D2 GPIO number"
            default 33 if IDF_TARGET_ESP32S3
            default 5

        config EXAMPLE_PIN_D3
            int "D3 GPIO number"
            default 34 if IDF_TARGET_ESP32S3
            default 6

    endmenu

    config EXAMPLE_HTTPD_CONN_CLOSE_HEADER
        bool "Send connection close header from request handlers"
        default y
        help
            If this config item is set, Connection: close header will be set in handlers.
            This closes HTTP connection and frees the server socket instantly.
endmenu
```
